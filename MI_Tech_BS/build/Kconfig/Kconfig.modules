## MI_Tech_BS/build/Kconfig/Kconfig.modules
```kconfig
menu "nrf (C:\nordicsemi\v1.6.1\nrf)"
osource "C:/nordicsemi/v1.6.1/nrf/Kconfig.nrf"
config ZEPHYR_NRF_MODULE
	bool
	default y
endmenu
menu "mcuboot (C:\nordicsemi\v1.6.1\bootloader\mcuboot)"
osource "$(ZEPHYR_MCUBOOT_KCONFIG)"
config ZEPHYR_MCUBOOT_MODULE
	bool
	default y
endmenu
menu "trusted-firmware-m (C:\nordicsemi\v1.6.1\modules\tee\tfm)"
osource "$(ZEPHYR_TRUSTED_FIRMWARE_M_KCONFIG)"
config ZEPHYR_TRUSTED_FIRMWARE_M_MODULE
	bool
	default y
endmenu
menu "cjson (C:\nordicsemi\v1.6.1\modules\lib\cjson)"
osource "$(ZEPHYR_CJSON_KCONFIG)"
config ZEPHYR_CJSON_MODULE
	bool
	default y
endmenu
menu "pelion-dm (C:\nordicsemi\v1.6.1\modules\lib\pelion-dm)"
osource "C:/nordicsemi/v1.6.1/modules/lib/pelion-dm/zephyr/Kconfig"
config ZEPHYR_PELION_DM_MODULE
	bool
	default y
endmenu
menu "cddl-gen (C:\nordicsemi\v1.6.1\modules\lib\cddl-gen)"
osource "$(ZEPHYR_CDDL_GEN_KCONFIG)"
config ZEPHYR_CDDL_GEN_MODULE
	bool
	default y
endmenu
menu "memfault-firmware-sdk (C:\nordicsemi\v1.6.1\modules\lib\memfault-firmware-sdk)"
osource "C:/nordicsemi/v1.6.1/modules/lib/memfault-firmware-sdk/ports/zephyr/Kconfig"
config ZEPHYR_MEMFAULT_FIRMWARE_SDK_MODULE
	bool
	default y
endmenu
menu "hal_nordic (C:\nordicsemi\v1.6.1\modules\hal\nordic)"
osource "$(ZEPHYR_HAL_NORDIC_KCONFIG)"
config ZEPHYR_HAL_NORDIC_MODULE
	bool
	default y
endmenu
menu "mbedtls (C:\nordicsemi\v1.6.1\modules\crypto\mbedtls)"
osource "$(ZEPHYR_MBEDTLS_KCONFIG)"
config ZEPHYR_MBEDTLS_MODULE
	bool
	default y
endmenu
menu "TraceRecorder (C:\nordicsemi\v1.6.1\modules\debug\TraceRecorder)"
osource "C:/nordicsemi/v1.6.1/modules/debug/TraceRecorder/kernelports/Zephyr/Kconfig"
config ZEPHYR_TRACERECORDER_MODULE
	bool
	default y
endmenu
menu "nrfxlib (C:\nordicsemi\v1.6.1\nrfxlib)"
osource "C:/nordicsemi/v1.6.1/nrfxlib/Kconfig.nrfxlib"
config ZEPHYR_NRFXLIB_MODULE
	bool
	default y
endmenu
menu "connectedhomeip (C:\nordicsemi\v1.6.1\modules\lib\matter)"
osource "C:/nordicsemi/v1.6.1/modules/lib/matter/config/nrfconnect/chip-module/Kconfig"
config ZEPHYR_CONNECTEDHOMEIP_MODULE
	bool
	default y
endmenu
```

## MI_Tech_BS/build_2/Kconfig/Kconfig.shield.defconfig
```kconfig
osource "C:/nordicsemi/v1.6.1/nrf/boards/shields/*/Kconfig.defconfig"
osource "C:/nordicsemi/v1.6.1/zephyr/boards/shields/*/Kconfig.defconfig"
```

## MI_Tech_BS/build_2/hci_rpmsg/Kconfig/Kconfig.shield
```kconfig
osource "C:/nordicsemi/v1.6.1/nrf/boards/shields/*/Kconfig.shield"
osource "C:/nordicsemi/v1.6.1/zephyr/boards/shields/*/Kconfig.shield"
```

## MI_Tech_BS/build_2/spm/Kconfig/Kconfig.soc.arch
```kconfig
osource "C:/nordicsemi/v1.6.1/zephyr/soc/$(ARCH)/Kconfig"
osource "C:/nordicsemi/v1.6.1/zephyr/soc/$(ARCH)/*/Kconfig"
```
